## arch/mips/jz4740/Kconfig
```kconfig
choice
	prompt "Machine type"
	depends on MACH_JZ4740
	default JZ4740_QI_LB60

config JZ4740_QI_LB60
	bool "Qi Hardware Ben NanoNote"

config JZ4740_QI_LB60_ATBEN
	bool "ATBEN 8:10 SPI-GPIO framework"
	depends on JZ4740_QI_LB60 && SPI && IEEE802154_AT86RF230
	---help---
	  Framework for the ATBEN IEEE 802.15.4 board in a Ben NanoNote.
	  Combines the AT86RF230 driver with a suitable SPI-GPIO driver
	  and provides glue functions and configuration data.

	  Say Y here to enable the ATBEN 8:10 SPI-GPIO framework.

endchoice
```

## drivers/net/ieee802154/Kconfig
```kconfig
menuconfig IEEE802154_DRIVERS
	tristate "IEEE 802.15.4 drivers"
	depends on NETDEVICES && IEEE802154
	default y
	---help---
	  Say Y here to get to see options for IEEE 802.15.4 Low-Rate
	  Wireless Personal Area Network device drivers. This option alone
	  does not add any kernel code.

	  If you say N, all options in this submenu will be skipped and
	  disabled.

config IEEE802154_FAKEHARD
	tristate "Fake LR-WPAN driver with several interconnected devices"
	depends on  IEEE802154_DRIVERS
	---help---
	  Say Y here to enable the fake driver that serves as an example
          of HardMAC device driver.

          This driver can also be built as a module. To do so say M here.
	  The module will be called 'fakehard'.

config IEEE802154_FAKELB
	depends on IEEE802154_DRIVERS && MAC802154
	tristate "IEEE 802.15.4 loopback driver"
	---help---
	  Say Y here to enable the fake driver that can emulate a net
	  of several interconnected radio devices.

	  This driver can also be built as a module. To do so say M here.
	  The module will be called 'fakelb'.

config IEEE802154_AT86RF230
        depends on IEEE802154_DRIVERS && MAC802154
        tristate "AT86RF230/231 transceiver driver"
        depends on SPI

config IEEE802154_SPI_ATBEN
	tristate "ATBEN 8:10 SPI interface"
	depends on IEEE802154_AT86RF230 && SPI && JZ4740_QI_LB60
	---help---
	  Bit-banging SPI driver for the 8:10 interface of the Ben NanoNote
	  when equipped with an ATBEN IEEE 802.15.4 board. This driver is
	  specifically designed to work underneath the AT86RF230 driver.

	  Say Y here to enable the ATBEN 8:10 SPI interface.

	  This driver can also be built as a module. To do so say M here.
	  The module will be called 'spi_atben'.

config IEEE802154_SPI_ATBEN_GPIO
	tristate "ATBEN 8:10 SPI interface"
	depends on IEEE802154_AT86RF230 && SPI && JZ4740_QI_LB60
	---help---
	  Alternative ATBEN driver using spi-gpio.

	  Say Y here to enable the ATBEN 8:10 SPI interface.

	  This driver can also be built as a module. To do so say M here.
	  The module will be called 'spi_atben_gpio'.

config IEEE802154_MRF24J40
       tristate "Microchip MRF24J40 transceiver driver"
       depends on IEEE802154_DRIVERS && MAC802154
       depends on SPI
       ---help---
         Say Y here to enable the MRF24J20 SPI 802.15.4 wireless
         controller.

         This driver can also be built as a module. To do so, say M here.
         the module will be called 'mrf24j40'.

config IEEE802154_ATUSB
	tristate "ATUSB transceiver driver"
	depends on IEEE802154_DRIVERS && MAC802154 && USB
	---help---
	  Say Y here to enable the ATUSB IEEE 802.15.4 wireless
	  controller.

	  This driver can also be built as a module. To do so say M here.
	  The module will be called 'atusb'.
```
